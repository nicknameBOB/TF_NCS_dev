## tensorflow_micro_speech/build/Kconfig.modules
```kconfig
osource "/home/jolu/ncs/nrf/Kconfig.nrf"

osource "/home/jolu/ncs/bootloader/mcuboot/zephyr/Kconfig"

osource "/home/jolu/ncs/nrfxlib/Kconfig.nrfxlib"
```

## west.yml
```yaml
manifest:
  remotes:
    - name: nordic
      url-base: https://github.com/NordicPlayground
    - name: tensorflow
      url-base: https://github.com/tensorflow
  projects:
    - name: fw-nrfconnect-nrf
      path: nrf
      remote: nordic
      revision: v1.3.0
      import: true
    - name: tensorflow
      path: tensorflow
      remote: tensorflow
      revision: v2.3.0
  self:
    path: tf_ncs_dev
```
